## CMakeLists.txt
```
cmake_minimum_required(VERSION 3.20.0)

set(CONF_FILE
  "${CMAKE_CURRENT_SOURCE_DIR}/prj.conf"
  "${CMAKE_CURRENT_SOURCE_DIR}/../DTMC_ZEPHYR_SYSTEM_COMMON.conf"
)

find_package(Zephyr REQUIRED HINTS $ENV{ZEPHYR_BASE})

project(app_zephyr)

include(${CMAKE_CURRENT_LIST_DIR}/../../dthelpers.cmake)
dthelpers_resolve(DTMC_ZEPHYR_DIR  dtmc_zephyr  "dtmc_zephyr repo directory")
dthelpers_resolve(DTMC_BASE_DIR    dtmc_base    "dtmc_base repo directory")
dthelpers_resolve(DTCORE_DIR       dtcore       "dtcore repo directory")

add_subdirectory(${DTCORE_DIR}/dtcore_library               ${CMAKE_BINARY_DIR}/dtcore_library)
add_subdirectory(${DTMC_BASE_DIR}/dtmc_base_library         ${CMAKE_BINARY_DIR}/dtmc_base_library)
add_subdirectory(${DTMC_BASE_DIR}/dtmc_base_benchmarks      ${CMAKE_BINARY_DIR}/dtmc_base_benchmarks)
add_subdirectory(${DTMC_ZEPHYR_DIR}/dtmc_zephyr_library     ${CMAKE_BINARY_DIR}/dtmc_zephyr_library)

target_include_directories(app PRIVATE
    ${DTMC_ZEPHYR_DIR}/dtmc_zephyr_library/include
    ${DTMC_BASE_DIR}/dtmc_base_benchmarks/include
    ${DTMC_BASE_DIR}/dtmc_base_library/include
    ${DTCORE_DIR}/dtcore_library/include
)

target_sources(app PRIVATE
    src/main.c
)

target_link_libraries(app PRIVATE
    dtmc_base_benchmarks
    dtmc_base_library
    dtcore_library
)
```

## prj.conf
```kconfig
# see DTMC_ZEPHYR_SYSTEM_COMMON.conf included by CMakeLists.txt

# counter driver required by dtinterval_zephyr_counter
CONFIG_COUNTER=y

# DWT CYCCNT halts during WFI; disable PM so cycle measurements stay valid
CONFIG_PM=n
```

## boards/nrf5340dk_nrf5340_cpuapp.overlay
```dts
/*
 * Enable TIMER1 as a Zephyr counter device for dtinterval_zephyr_counter.
 * TIMER1 runs at 1MHz (16MHz HFXO / prescaler 4) giving 1us resolution.
 * It is not used by the Zephyr kernel or BT stack on the nRF5340 app core.
 */
&timer1 {
    status = "okay";
    prescaler = <4>;
};
```

## src/main.c
```c
#include <zephyr/device.h>

#include <dtcore/dterr.h>
#include <dtcore/dtlog.h>
#include <dtcore/dtstr.h>

#include <dtmc_base/dtruntime.h>

#include <dtmc/dtinterval_zephyr_counter.h>

#include <dtmc_base_benchmarks/benchmark_interval.h>

#define TAG "main"

#define BENCHMARK_INTERVAL_US 10000 // 10ms nominal period

// --------------------------------------------------------------------------------------
int
main(int argc, char* argv[])
{
    dterr_t* dterr = NULL;
    dtinterval_zephyr_counter_t* interval = NULL;
    benchmark_t* benchmark = NULL;

    {
        char* s = NULL;
        DTERR_C(dtruntime_format_devices_as_table(&s));
        dtlog_info(TAG, "devices:\n%s", s);
        dtstr_dispose(s);
    }

    // === create and configure the interval ===
    {
        DTERR_C(dtinterval_zephyr_counter_create(&interval));

        dtinterval_zephyr_counter_config_t c = {
            .name = "benchmark",
            .periodic_interval_micros = BENCHMARK_INTERVAL_US,
            .counter_dev = DEVICE_DT_GET(DT_NODELABEL(timer1)),
        };
        DTERR_C(dtinterval_zephyr_counter_configure(interval, &c));
    }

    // === create and configure the benchmark ===
    {
        DTERR_C(benchmark_create(&benchmark));

        benchmark_config_t c = { 0 };
        c.interval_handle = (dtinterval_handle)interval;
        c.nominal_interval_us = BENCHMARK_INTERVAL_US;
        c.app_core = 0;

        DTERR_C(benchmark_configure(benchmark, &c));
    }

    // === run the benchmark (blocks until collection is done, then prints results) ===
    DTERR_C(benchmark_start(benchmark));

cleanup:
    dtlog_dterr(TAG, dterr);
    dterr_dispose(dterr);

    benchmark_dispose(benchmark);
    dtinterval_zephyr_counter_dispose(interval);

    exit(dterr ? -1 : 0);
}
```
