## CMakeLists.txt
```
cmake_minimum_required(VERSION 3.20.0)

set(CONF_FILE
  "${CMAKE_CURRENT_SOURCE_DIR}/prj.conf"
  "${CMAKE_CURRENT_SOURCE_DIR}/../DTRTOS_ZEPHYR_DTIOX_CAN_COMMON.conf"
)

find_package(Zephyr REQUIRED HINTS $ENV{ZEPHYR_BASE})

project(app_zephyr)

set(DTCORE_LIBRARY        ${CMAKE_CURRENT_SOURCE_DIR}/../../dtcore_library)
set(DTMC_BASE_LIBRARY     ${CMAKE_CURRENT_SOURCE_DIR}/../../dtmc_base_library)
set(DTMC_BASE_DEMOS       ${CMAKE_CURRENT_SOURCE_DIR}/../../dtmc_base_demos)
set(DTMC_ZEPHYR_LIBRARY   ${CMAKE_CURRENT_SOURCE_DIR}/../../dtmc_zephyr_library)

# Bring in external object libraries
add_subdirectory(${DTCORE_LIBRARY}        ${CMAKE_BINARY_DIR}/dtcore_library)
add_subdirectory(${DTMC_BASE_LIBRARY}     ${CMAKE_BINARY_DIR}/dtmc_base_library)
add_subdirectory(${DTMC_BASE_DEMOS}       ${CMAKE_BINARY_DIR}/dtmc_base_demos)
add_subdirectory(${DTMC_ZEPHYR_LIBRARY}   ${CMAKE_BINARY_DIR}/dtmc_zephyr_library)

target_include_directories(app PRIVATE
    ${DTCORE_LIBRARY}/include
    ${DTMC_BASE_LIBRARY}/include
    ${DTMC_BASE_DEMOS}/include
    ${DTMC_ZEPHYR_LIBRARY}/include
)

# Use the Zephyr build target (called 'app') – this is created implicitly
target_sources(app PRIVATE
    src/main.c
)
```

## prj.conf
```kconfig
# ---- newlib configuration
CONFIG_NEWLIB_LIBC=y
# without this, PRIu64 doesn't work in printf or printk
CONFIG_NEWLIB_LIBC_NANO=n
# enable float support in printf, adds 1-2kB to the binary
CONFIG_NEWLIB_LIBC_FLOAT_PRINTF=y

# ---- console configuration
CONFIG_STDOUT_CONSOLE=y
CONFIG_SERIAL=y
CONFIG_CONSOLE=y
CONFIG_UART_CONSOLE=y

# ---- logging
CONFIG_LOG=y
CONFIG_LOG_BACKEND_SHOW_COLOR=n
CONFIG_LOG_MODE_IMMEDIATE=y
CONFIG_LOG_DEFAULT_LEVEL=3

# ---- memory configuration
# our dtlog uses at least 1k
CONFIG_MAIN_STACK_SIZE=4096
CONFIG_HEAP_MEM_POOL_SIZE=32768

# ---- kernel configuration
CONFIG_EVENTS=y
CONFIG_KERNEL_SHELL=y

# ---- system clock configuration
# makes Zephyr tick every 1 ms instead of the default 100 Hz (10 ms)
CONFIG_SYS_CLOCK_EXISTS=y
CONFIG_SYS_CLOCK_TICKS_PER_SEC=1000

# ---- thread monitoring and analysis
# CONFIG_THREAD_ANALYZER selects INIT_STACKS, THREAD_MONITOR, THREAD_STACK_INFO, THREAD_RUNTIME_STATS
CONFIG_THREAD_ANALYZER=y
CONFIG_THREAD_NAME=y
CONFIG_THREAD_ANALYZER_AUTO=n

# ==== stack overflow detection and diagnostics
CONFIG_STACK_SENTINEL=y
CONFIG_STACK_CANARIES=y

# ---- bluetooth configuration
# see DTMC_ZEPHYR_RPC_HOST_COMMON.conf included by CMakeLists.txt

# ---- CoAP configuration
# see DTMC_ZEPHYR_OPENTHREAD_COAP_COMMON.conf included by CMakeLists.txt

# ---- CAN configuration
# see DTMC_ZEPHYR_DTIOX_CAN_COMMON.conf included by CMakeLists.txt
```

## boards/nrf5340dk_nrf5340_cpuapp.overlay
```dts
/* a second UART (uart1) on Tx=P1.01 Rx=P1.00 */
&uart1 {
    label = "demo_uart";
    status = "okay";
};
```

## src/main.c
```c
#include <dtcore/dterr.h>

#include <dtcore/dtlog.h>
#include <dtcore/dtstr.h>

#include <dtmc_base/dtiox.h>
#include <dtmc_base/dtruntime.h>
#include <dtmc_base/dtuart_helpers.h>
#include <dtmc_base_demos/demo_iox.h>

#include <dtmc/dtiox_zephyr_uartirq.h>

#define TAG "main"

// some local macros referring to the current demo to make it a bit easier to read the code
#define demo_t dtmc_base_demo_iox_t
#define demo_config_t dtmc_base_demo_iox_config_t
#define demo_create dtmc_base_demo_iox_create
#define demo_configure dtmc_base_demo_iox_configure
#define demo_start dtmc_base_demo_iox_start
#define demo_dispose dtmc_base_demo_iox_dispose

// --------------------------------------------------------------------------------------
int
main(int argc, char* argv[])
{
    dterr_t* dterr = NULL;
    dtiox_handle uart_handle = NULL;
    demo_t* demo = NULL;

    // ==== print the currently registered devices ====
    {
        char* s = NULL;
        DTERR_C(dtruntime_format_devices_as_table(&s));

        dtlog_info(TAG, "devices:\n%s", s);

        dtstr_dispose(s);
    }

    // === create the concrete UART object we need ===
    {
        dtiox_zephyr_uartirq_t* o = NULL;
        DTERR_C(dtiox_zephyr_uartirq_create(&o));
        uart_handle = (dtiox_handle)o;

        dtiox_zephyr_uartirq_config_t c = { 0 };
        c.device_tree_name = "demo_uart";
        c.uart_config = dtuart_helper_default_config;

        DTERR_C(dtiox_zephyr_uartirq_configure(o, &c));
    }

    // === create and configure the demo instance ===
    {
        DTERR_C(demo_create(&demo));
        demo_config_t c = { 0 };
        c.uart_handle = uart_handle;
        DTERR_C(demo_configure(demo, &c));
    }

    // === start the demo ===
    DTERR_C(demo_start(demo));

cleanup:
    int rc = (dterr != NULL) ? -1 : 0;

    // log and dispose error chain if any
    dtlog_dterr(TAG, dterr);
    dterr_dispose(dterr);

    // dispose the demo instance
    demo_dispose(demo);

    // dispose the UART instance
    dtiox_dispose(uart_handle);

    return rc;
}
```
