## CMakeLists.txt
```
cmake_minimum_required(VERSION 3.20.0)

set(CONF_FILE
  "${CMAKE_CURRENT_SOURCE_DIR}/prj.conf"
  "${CMAKE_CURRENT_SOURCE_DIR}/../DTMC_ZEPHYR_SYSTEM_COMMON.conf"
  "${CMAKE_CURRENT_SOURCE_DIR}/../DTMC_ZEPHYR_DTIOX_UART_COMMON.conf"
  "${CMAKE_CURRENT_SOURCE_DIR}/../DTMC_ZEPHYR_SHELL.conf"
)

find_package(Zephyr REQUIRED HINTS $ENV{ZEPHYR_BASE})

project(app_zephyr)

include(${CMAKE_CURRENT_LIST_DIR}/../../dthelpers.cmake)
dthelpers_resolve(DTMC_ZEPHYR_DIR dtmc_zephyr "dtmc_zephyr repo directory")
dthelpers_resolve(DTMC_BASE_DIR dtmc_base "dtmc_base repo directory")
dthelpers_resolve(DTCORE_DIR dtcore "dtcore repo directory")

add_subdirectory(${DTMC_BASE_DIR}/dtmc_base_demos       ${CMAKE_BINARY_DIR}/dtmc_base_demos)
add_subdirectory(${DTMC_ZEPHYR_DIR}/dtmc_zephyr_library ${CMAKE_BINARY_DIR}/dtmc_zephyr_library)
add_subdirectory(${DTMC_BASE_DIR}/dtmc_base_library     ${CMAKE_BINARY_DIR}/dtmc_base_library)
add_subdirectory(${DTCORE_DIR}/dtcore_library           ${CMAKE_BINARY_DIR}/dtcore_library)

target_include_directories(app PRIVATE
    ${DTMC_BASE_DIR}/dtmc_base_demos/include
    ${DTMC_ZEPHYR_DIR}/dtmc_zephyr_library/include
    ${DTMC_BASE_DIR}/dtmc_base_library/include
    ${DTCORE_DIR}/dtcore_library/include
)

target_sources(app PRIVATE
    src/main.c
)

target_link_libraries(app PRIVATE
    dtmc_base_demos
    dtmc_base_library
    dtcore_library
)
```

## prj.conf
```kconfig
CONFIG_ADC=y
CONFIG_COUNTER=y
```

## boards/nrf5340dk_nrf5340_cpuapp.overlay
```dts
&timer1 {
    status = "okay";
    prescaler = <4>;
};

/* a second UART (uart1) on Tx=P1.01 Rx=P1.00 */
&uart1 {
    label = "demo_uart";
    status = "okay";
};

/* native USB CDC ACM virtual serial port */
&zephyr_udc0 {
    cdc_acm_uart0: cdc_acm_uart0 {
        compatible = "zephyr,cdc-acm-uart";
        label = "CDC_ACM_0";
        status = "okay";
    };
};
```

## src/main.c
```c
#include <dtcore/dterr.h>

#include <dtcore/dtlog.h>
#include <dtcore/dtstr.h>

#include <dtmc_base/dtruntime.h>

#include <dtmc_base/dtadc.h>
#include <dtmc_base/dtframer.h>
#include <dtmc_base/dtiox.h>
#include <dtmc_base/dtsemaphore.h>
#include <dtmc_base/dttasker.h>

// we can cover these concrete objects platform agnostically
#include <dtmc_base/dtadc.h>

// these concrete objects are platform specific
#include <dtmc/dtadc_zephyr_saadc.h>

#include <dtmc_base_demos/demo_adc_print.h>

#define TAG "main"

// --------------------------------------------------------------------------------------
int
main(int argc, char* argv[])
{
    dterr_t* dterr = NULL;
    dtadc_handle adc_handle = NULL;

    demo_t* demo = NULL;

    // ==== print the currently registered devices ====
    {
        char* s = NULL;
        DTERR_C(dtruntime_format_devices_as_table(&s));

        dtlog_info(TAG, "devices:\n%s", s);

        dtstr_dispose(s);
    }

    // === create the concrete UART object we need ===
    {
        dtadc_zephyr_saadc_t* o = NULL;
        DTERR_C(dtadc_zephyr_saadc_create(&o));
        adc_handle = (dtadc_handle)o;

        dtadc_zephyr_saadc_config_t c = { 0 };
        dtadc_zephyr_saadc_config_init_defaults(&c);
        c.counter_dev = DEVICE_DT_GET(DT_NODELABEL(timer1));
        DTERR_C(dtadc_zephyr_saadc_configure(o, &c));
    }

    // === create and configure the demo instance ===
    {
        DTERR_C(demo_create(&demo));
        demo_config_t c = { 0 };
        c.adc_handle = adc_handle;
        c.scan_timeout_ms = 10000;
        c.max_scan_count = 10;
        DTERR_C(demo_configure(demo, &c));
    }

    // === start the demo ===
    DTERR_C(demo_start(demo));

cleanup:
    int rc = (dterr != NULL) ? -1 : 0;

    // log and dispose error chain if any
    dtlog_dterr(TAG, dterr);

    dterr_dispose(dterr);

    // dispose the demo instance
    demo_dispose(demo);

    // dispose the objects

    dtadc_dispose(adc_handle);

    return rc;
}
```
