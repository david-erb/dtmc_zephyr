## CMakeLists.txt
```
cmake_minimum_required(VERSION 3.20.0)

set(CONF_FILE
  "${CMAKE_CURRENT_SOURCE_DIR}/prj.conf"
  "${CMAKE_CURRENT_SOURCE_DIR}/../DTMC_ZEPHYR_GPIOPIN_COMMON.conf"
)

find_package(Zephyr REQUIRED HINTS $ENV{ZEPHYR_BASE})

project(app_zephyr)

set(DTCORE_LIBRARY        ${CMAKE_CURRENT_SOURCE_DIR}/../../dtcore_library)
set(DTMC_BASE_LIBRARY     ${CMAKE_CURRENT_SOURCE_DIR}/../../dtmc_base_library)
set(DTMC_BASE_DEMOS       ${CMAKE_CURRENT_SOURCE_DIR}/../../dtmc_base_demos)
set(DTMC_ZEPHYR_LIBRARY   ${CMAKE_CURRENT_SOURCE_DIR}/../../dtmc_zephyr_library)

# Bring in external object libraries
add_subdirectory(${DTCORE_LIBRARY}        ${CMAKE_BINARY_DIR}/dtcore_library)
add_subdirectory(${DTMC_BASE_LIBRARY}     ${CMAKE_BINARY_DIR}/dtmc_base_library)
add_subdirectory(${DTMC_BASE_DEMOS}       ${CMAKE_BINARY_DIR}/dtmc_base_demos)
add_subdirectory(${DTMC_ZEPHYR_LIBRARY}   ${CMAKE_BINARY_DIR}/dtmc_zephyr_library)

target_include_directories(app PRIVATE
    ${DTCORE_LIBRARY}/include
    ${DTMC_BASE_LIBRARY}/include
    ${DTMC_BASE_DEMOS}/include
    ${DTMC_ZEPHYR_LIBRARY}/include
)

# Use the Zephyr build target (called 'app') – this is created implicitly
target_sources(app PRIVATE
    src/main.c
)
```

## prj.conf
```kconfig
# ---- newlib configuration
CONFIG_NEWLIB_LIBC=y
# without this, PRIu64 doesn't work in printf or printk
CONFIG_NEWLIB_LIBC_NANO=n
# enable float support in printf, adds 1-2kB to the binary
CONFIG_NEWLIB_LIBC_FLOAT_PRINTF=y

# ---- console configuration
CONFIG_STDOUT_CONSOLE=y
CONFIG_SERIAL=y
CONFIG_CONSOLE=y
CONFIG_UART_CONSOLE=y

# ---- logging
CONFIG_LOG=y
CONFIG_LOG_BACKEND_SHOW_COLOR=n
CONFIG_LOG_MODE_IMMEDIATE=y
CONFIG_LOG_DEFAULT_LEVEL=3

# ---- memory configuration
# our dtlog uses at least 1k
CONFIG_MAIN_STACK_SIZE=4096
CONFIG_HEAP_MEM_POOL_SIZE=32768

# ---- kernel configuration
CONFIG_EVENTS=y
CONFIG_KERNEL_SHELL=y

# ---- system clock configuration
# makes Zephyr tick every 1 ms instead of the default 100 Hz (10 ms)
CONFIG_SYS_CLOCK_EXISTS=y
CONFIG_SYS_CLOCK_TICKS_PER_SEC=1000

# ---- thread monitoring and analysis
# CONFIG_THREAD_ANALYZER selects INIT_STACKS, THREAD_MONITOR, THREAD_STACK_INFO, THREAD_RUNTIME_STATS
CONFIG_THREAD_ANALYZER=y
CONFIG_THREAD_NAME=y
CONFIG_THREAD_ANALYZER_AUTO=n

# ==== stack overflow detection and diagnostics
CONFIG_STACK_SENTINEL=y
CONFIG_STACK_CANARIES=y

# ---- bluetooth configuration
# see DTMC_ZEPHYR_RPC_HOST_COMMON.conf included by CMakeLists.txt

# ---- CoAP configuration
# see DTMC_ZEPHYR_OPENTHREAD_COAP_COMMON.conf included by CMakeLists.txt

# ---- GPIO configuration
# see DTMC_ZEPHYR_GPIOPIN_COMMON.conf included by CMakeLists.txt
```

## src/main.c
```c
#include <dtcore/dterr.h>

#include <dtcore/dtlog.h>
#include <dtcore/dtstr.h>

#include <dtmc_base/dtgpiopin.h>
#include <dtmc_base_demos/demo_gpiopin_record.h>

#include <dtmc/dtgpiopin_zephyr.h>

#include <dtmc_base/dtcpu.h>

#define TAG "main"

// --------------------------------------------------------------------------------------
int
main(int argc, char* argv[])
{
    dterr_t* dterr = NULL;
    dtgpiopin_handle gpiopin_handle = NULL;
    demo_t* demo = NULL;

    const char* pin_name = "";

    // === create the concrete object we need ===
    {
        dtgpiopin_zephyr_t* o = NULL;
        DTERR_C(dtgpiopin_zephyr_create(&o));
        gpiopin_handle = (dtgpiopin_handle)o;
        dtgpiopin_zephyr_config_t c = { 0 };
        c.pin_number = 32; // P1.0 on nRF5340-DK
        pin_name = "P1.00";
        c.mode = DTGPIOPIN_MODE_INPUT;
        c.pull = DTGPIOPIN_PULL_UP;
        DTERR_C(dtgpiopin_zephyr_configure(o, &c));
    }

    dtlog_info(TAG, "starting demo: %s (%s) on GPIO pin %s", demo_name, demo_title, pin_name);

    // === create and configure the demo instance ===
    {
        DTERR_C(demo_create(&demo));
        demo_config_t c = { 0 };
        c.gpiopin_handle = gpiopin_handle;
        c.pin_name = pin_name;
        DTERR_C(demo_configure(demo, &c));
    }

    // === start the demo ===
    DTERR_C(demo_start(demo));

cleanup:
    // log and dispose error chain (if any)
    dtlog_dterr(TAG, dterr);
    dterr_dispose(dterr);

    // dispose because start has left things running
    demo_dispose(demo);

    // dispose the GPIO pin instance
    dtgpiopin_dispose(gpiopin_handle);

    dtlog_info(TAG, "demo finished");

    return 0;
}
```
